## prj.conf
```kconfig
CONFIG_FLASH=y
CONFIG_FLASH_MAP=y
CONFIG_FLASH_PAGE_LAYOUT=y
CONFIG_FILE_SYSTEM=y
CONFIG_FILE_SYSTEM_LITTLEFS=y
CONFIG_LOG=y
CONFIG_FS_LITTLEFS_FC_HEAP_SIZE=16384
CONFIG_FAT_FILESYSTEM_ELM=y
CONFIG_DISK_DRIVER_RAM=y
CONFIG_DISK_RAM_VOLUME_SIZE=80
CONFIG_HEAP_MEM_POOL_SIZE=4096
CONFIG_MAIN_STACK_SIZE=4096
CONFIG_ZTEST_STACK_SIZE=4096
CONFIG_ZTEST=y
CONFIG_ZTEST_NEW_API=y
CONFIG_NO_OPTIMIZATIONS=y
```

## prj_fs_shell.conf
```kconfig
CONFIG_FLASH=y
CONFIG_FLASH_MAP=y
CONFIG_FLASH_PAGE_LAYOUT=y
CONFIG_FILE_SYSTEM=y
CONFIG_FILE_SYSTEM_LITTLEFS=y
CONFIG_LOG=y
CONFIG_SHELL=y
CONFIG_SHELL_BACKEND_SERIAL=n
CONFIG_SHELL_BACKEND_DUMMY=y
CONFIG_SHELL_CMD_BUFF_SIZE=90
CONFIG_FILE_SYSTEM_SHELL=y
CONFIG_FAT_FILESYSTEM_ELM=y
CONFIG_DISK_DRIVER_RAM=y
CONFIG_DISK_RAM_VOLUME_SIZE=80
CONFIG_HEAP_MEM_POOL_SIZE=1024
CONFIG_MAIN_STACK_SIZE=1024
CONFIG_ZTEST_STACK_SIZE=2048
CONFIG_ZTEST=y
CONFIG_ZTEST_NEW_API=y
```

## src/main.c
```c
/*
 * Copyright (c) 2018 Codecoup
 *
 * SPDX-License-Identifier: Apache-2.0
 */

#include <ztest.h>
#include "test_common.h"
#include "test_fs_shell.h"
#include "test_fat.h"
#include "test_littlefs.h"

void *fs_mount_setup(void)
{
	int err;
	err = fat_mount_setup();
	zassert_true(err == 0, "fat_fs_mount setup call failure: %d", err);

	err = littlefs_mount_setup();
	zassert_true(err == 0, "littlefs_fs_mount setup call failure: %d", err);
	return NULL;
}

void fs_unmount_teardown(void *data)
{
	ARG_UNUSED(data);
	int err;

	err = fat_unmount_teardown();
	zassert_true(err == 0, "fat_fs_unmount teardown call failure: %d", err);

	err = littlefs_unmount_teardown();
	zassert_true(err == 0, "littlefs_fs_unmount teardown call failure: %d", err);
}

ZTEST_SUITE(multifs_fs_dir_file, NULL, fs_mount_setup, NULL, NULL, fs_unmount_teardown);
ZTEST_SUITE(multifs_fs, NULL, NULL, NULL, NULL, fs_unmount_teardown);
```

## src/test_common.h
```c
/*
 * Copyright (c) 2020 Nordic Semiconductor ASA
 *
 * SPDX-License-Identifier: Apache-2.0
 */

#include <ztest.h>
#include <zephyr/fs/fs.h>
#include <limits.h>

void test_clear_flash(void);
int check_file_dir_exists(const char *fpath);

int test_file_open(struct fs_file_t *filep, const char *fpath);
int test_file_write_read(struct fs_file_t *filep, const char *str, const char *file_path);
int test_file_close(struct fs_file_t *filep);
int test_file_delete(const char *fpath);


int test_rmdir(const char *dir_path);
int test_mkdir(const char *dir_path, const char *file);
int test_lsdir(const char *path);
```

## src/test_common_dir.c
```c
/*
 * Copyright (c) 2018 Intel Corporation.
 *
 * SPDX-License-Identifier: Apache-2.0
 */

#include <ztest.h>
#include <stdio.h>
#include <limits.h>
#include <zephyr/sys/__assert.h>
#include <zephyr/fs/fs.h>
#include "test_common.h"

#ifndef PATH_MAX
#define PATH_MAX 4096
#endif

int test_mkdir(const char *dir_path, const char *file)
{
	int res;
	struct fs_file_t filep;
	char file_path[PATH_MAX] = { 0 };

	fs_file_t_init(&filep);
	res = sprintf(file_path, "%s/%s", dir_path, file);
	__ASSERT_NO_MSG(res < sizeof(file_path));

	if (check_file_dir_exists(dir_path)) {
		TC_PRINT("[%s] exists, delete it\n", dir_path);
		if (test_rmdir(dir_path)) {
			TC_PRINT("Error deleting dir %s\n", dir_path);
			return TC_FAIL;
		}
	} else {
		TC_PRINT("Creating new dir %s\n", dir_path);
	}

	/* Verify fs_mkdir() */
	res = fs_mkdir(dir_path);
	if (res) {
		TC_PRINT("Error creating dir[%d]\n", res);
		return res;
	}

	res = fs_open(&filep, file_path, FS_O_CREATE | FS_O_RDWR);
	if (res) {
		TC_PRINT("Failed opening file [%d]\n", res);
		return res;
	}

	TC_PRINT("Testing write to file %s and read from it\n", file_path);
	res = test_file_write_read(&filep, "NOTHING", file_path);
	if (res) {
		fs_close(&filep);
		return res;
	}

	res = fs_close(&filep);
	if (res) {
		TC_PRINT("Error closing file [%d]\n", res);
		return res;
	}

	TC_PRINT("Created dir %s!\n", dir_path);

	return res;
}

int test_lsdir(const char *path)
{
	int res;
	struct fs_dir_t dirp;
	struct fs_dirent entry;

	TC_PRINT("\nlsdir tests:\n");

	fs_dir_t_init(&dirp);

	/* Verify fs_opendir() */
	res = fs_opendir(&dirp, path);
	if (res) {
		TC_PRINT("Error opening dir %s [%d]\n", path, res);
		return res;
	}

	TC_PRINT("\nListing dir %s:\n", path);
	for (;;) {
		/* Verify fs_readdir() */
		res = fs_readdir(&dirp, &entry);

		/* entry.name[0] == 0 means end-of-dir */
		if (res || entry.name[0] == 0) {
			break;
		}

		if (entry.type == FS_DIR_ENTRY_DIR) {
			TC_PRINT("[DIR ] %s\n", entry.name);
		} else {
			TC_PRINT("[FILE] %s (size = %zu)\n",
				entry.name, entry.size);
		}
	}

	/* Verify fs_closedir() */
	fs_closedir(&dirp);

	return res;
}

int test_rmdir(const char *dir_path)
{
	int res;
	struct fs_dir_t dirp;
	static struct fs_dirent entry;

	fs_dir_t_init(&dirp);

	if (!check_file_dir_exists(dir_path)) {
		TC_PRINT("%s doesn't exist\n", dir_path);
		return TC_FAIL;
	}

	res = fs_opendir(&dirp, dir_path);
	if (res) {
		TC_PRINT("Error opening dir[%d]\n", res);
		return res;
	}

	TC_PRINT("\nRemoving files and sub directories in %s\n", dir_path);
	for (;;) {
		char file_path[PATH_MAX] = { 0 };

		res = fs_readdir(&dirp, &entry);

		/* entry.name[0] == 0 means end-of-dir */
		if (res || entry.name[0] == 0) {
			break;
		}

		/* Delete file or sub directory */
		sprintf(file_path, "%s/%s", dir_path, entry.name);
		__ASSERT_NO_MSG(res < sizeof(file_path));
		TC_PRINT("Removing %s\n", file_path);

		res = fs_unlink(file_path);
		if (res) {
			TC_PRINT("Error deleting file/dir [%d]\n", res);
			fs_closedir(&dirp);
			return res;
		}
	}

	fs_closedir(&dirp);

	/* Verify fs_unlink() */
	res = fs_unlink(dir_path);
	if (res) {
		TC_PRINT("Error removing dir [%d]\n", res);
		return res;
	}

	TC_PRINT("Removed dir %s!\n", dir_path);

	return res;
}
```

## src/test_common_file.c
```c
/*
 * Copyright (c) 2018 Intel Corporation.
 *
 * SPDX-License-Identifier: Apache-2.0
 */

#include <ztest.h>
#include <string.h>
#include <zephyr/fs/fs.h>
#include "test_common.h"

int test_file_open(struct fs_file_t *filep, const char *file_path)
{
	int res;

	TC_PRINT("\nOpen tests:\n");

	if (check_file_dir_exists(file_path)) {
		TC_PRINT("Opening existing file %s\n", file_path);
	} else {
		TC_PRINT("Creating new file %s\n", file_path);
	}

	/* Verify fs_open() */
	res = fs_open(filep, file_path, FS_O_CREATE | FS_O_RDWR);
	if (res) {
		TC_PRINT("Failed opening file [%d]\n", res);
		return res;
	}

	TC_PRINT("Opened file %s\n", file_path);

	return res;
}

int test_file_write_read(struct fs_file_t *filep, const char *test_str, const char *file_path)
{
	ssize_t brw;
	int res;
	char read_buff[80];
	size_t sz = strlen(test_str);

	TC_PRINT("\nWrite and read tests:\n");

	/* open the file */
	test_file_open(filep, file_path);

	/* Verify fs_seek() */
	res = fs_seek(filep, 0, FS_SEEK_SET);
	if (res) {
		TC_PRINT("fs_seek failed [%d]\n", res);
		fs_close(filep);
		return res;
	}

	TC_PRINT("Data written:\"%s\"\n\n", test_str);

	/* Verify fs_write() */
	brw = fs_write(filep, (char *)test_str, strlen(test_str));
	if (brw < 0) {
		TC_PRINT("Failed writing to file [%zd]\n", brw);
		fs_close(filep);
		return brw;
	}

	if (brw < strlen(test_str)) {
		TC_PRINT("Unable to complete write. Volume full.\n");
		TC_PRINT("Number of bytes written: [%zd]\n", brw);
		fs_close(filep);
		return TC_FAIL;
	}

	TC_PRINT("Data successfully written!\n");

	/* Verify fs_read() */
	brw = fs_read(filep, read_buff, sz);
	if (brw < 0) {
		TC_PRINT("Failed reading file [%zd]\n", brw);
		fs_close(filep);
		return brw;
	}

	read_buff[brw] = 0;

	TC_PRINT("Data read:\"%s\"\n\n", read_buff);

	if (strcmp(test_str, read_buff)) {
		TC_PRINT("Error - Data read does not match data written\n");
		TC_PRINT("Data read:\"%s\"\n\n", read_buff);
		return TC_FAIL;
	}

	TC_PRINT("Data read matches data written\n");

	return res;
}

int test_file_close(struct fs_file_t *filep)
{
	int res;

	TC_PRINT("\nClose tests:\n");

	res = fs_close(filep);
	if (res) {
		TC_PRINT("Error closing file [%d]\n", res);
		return res;
	}


	return res;
}

int test_file_delete(const char *file_path)
{
	int res;


	TC_PRINT("\nDelete tests:\n");

	/* Verify fs_unlink() */
	res = fs_unlink(file_path);
	if (res) {
		TC_PRINT("Error deleting file [%d]\n", res);
		return res;
	}

	/* Check if file was deleted */
	if (check_file_dir_exists(file_path)) {
		TC_PRINT("Failed deleting %s\n", file_path);
		return TC_FAIL;
	}

	TC_PRINT("File (%s) deleted successfully!\n", file_path);

	return res;
}
```

## src/test_fat.h
```c
/*
 * Copyright (c) 2018 Intel Corporation.
 *
 * SPDX-License-Identifier: Apache-2.0
 */

int fat_mount_setup(void);
int fat_unmount_teardown(void);
```

## src/test_fat_dir.c
```c
/*
 * Copyright (c) 2018 Intel Corporation.
 *
 * SPDX-License-Identifier: Apache-2.0
 */

#include <stdio.h>
#include <zephyr/fs/fs.h>
#include "test_common.h"
#include "test_fat_priv.h"

ZTEST(multifs_fs_dir_file, test_fat_mkdir)
{
	zassert_true(test_mkdir(TEST_DIR_PATH, TEST_FILE) == TC_PASS, NULL);
}

ZTEST(multifs_fs_dir_file, test_fat_readdir)
{
	zassert_true(test_lsdir(TEST_DIR_PATH) == TC_PASS, NULL);
}

ZTEST(multifs_fs_dir_file, test_fat_rmdir)
{
	zassert_true(test_rmdir(TEST_DIR_PATH) == TC_PASS, NULL);
}
```

## src/test_fat_file.c
```c
/*
 * Copyright (c) 2018 Intel Corporation.
 *
 * SPDX-License-Identifier: Apache-2.0
 */

#include <zephyr/fs/fs.h>
#include "test_common.h"
#include "test_fat_priv.h"

static struct fs_file_t test_file;
static const char *test_str = "Hello world FAT";

ZTEST(multifs_fs_dir_file, test_fat_open)
{
	fs_file_t_init(&test_file);
	zassert_true(test_file_open(&test_file, TEST_FILE_PATH) == TC_PASS,
		NULL);
}

ZTEST(multifs_fs_dir_file, test_fat_write_read)
{
	TC_PRINT("Write to file %s and read from it\n", TEST_FILE_PATH);
	zassert_true(test_file_write_read(&test_file, test_str) == TC_PASS,
		NULL);
}

ZTEST(multifs_fs_dir_file, test_fat_close)
{
	zassert_true(test_file_close(&test_file) == TC_PASS, NULL);
}

ZTEST(multifs_fs_dir_file, test_fat_unlink)
{
	zassert_true(test_file_delete(TEST_FILE_PATH) == TC_PASS, NULL);
}
```

## src/test_fat_mount.c
```c
/*
 * Copyright (c) 2018 Intel Corporation.
 *
 * SPDX-License-Identifier: Apache-2.0
 */

#include <ff.h>
#include "test_common.h"
#include "test_fs_shell.h"
#include "test_fat.h"
#include "test_fat_priv.h"

/* for mount using FS api */
#if !defined(CONFIG_FILE_SYSTEM_SHELL)
/* FatFs work area */
static FATFS fat_fs;

/* mounting info */
static struct fs_mount_t fatfs_mnt = {
	.type = FS_FATFS,
	.mnt_point = FATFS_MNTP,
	.fs_data = &fat_fs,
};

static int test_mount(void)
{
	int res;

	res = fs_mount(&fatfs_mnt);
	if (res < 0) {
		TC_PRINT("Error mounting fs [%d]\n", res);
		return TC_FAIL;
	}

	return TC_PASS;
}

int fat_mount_setup(void)
{
	int res;

	res = fs_mount(&fatfs_mnt);
	return res;
}

int fat_unmount_teardown(void)
{
	int res;

	res = fs_unmount(&fatfs_mnt);
	return res;
}
#endif

ZTEST(multifs_fs, test_fat_mount)
{
#ifdef CONFIG_FILE_SYSTEM_SHELL
	test_fs_fat_mount();
#else
	zassert_true(test_mount() == TC_PASS, NULL);
#endif
}
```

## src/test_fs_shell.c
```c
/*
 * Copyright (c) 2018 Intel Corporation
 *
 * SPDX-License-Identifier: Apache-2.0
 */

/** @file
 *  @brief Interactive shell test suite
 *
 */

#include <zephyr/zephyr.h>
#include <ztest.h>

#include "test_fs_shell.h"
#include <zephyr/shell/shell.h>

static void test_shell_exec(const char *line, int result)
{
	int ret;

	ret = shell_execute_cmd(NULL, line);

	TC_PRINT("shell_execute_cmd(%s): %d\n", line, ret);

	zassert_true(ret == result, line);
}

ZTEST(multifs_fs, test_fs_help)
{
#ifdef CONFIG_FILE_SYSTEM_SHELL
	test_shell_exec("help", 0);
	test_shell_exec("help fs", -EINVAL);
	test_shell_exec("fs mount fat", -EINVAL);
	test_shell_exec("fs mount littlefs", -EINVAL);
#else
	ztest_test_skip();
#endif
}

void test_fs_fat_mount(void)
{
	test_shell_exec("fs mount fat /RAM:", 0);
}
void test_fs_littlefs_mount(void)
{
	test_shell_exec("fs mount littlefs /littlefs", 0);
}
```

## src/test_littlefs.h
```c
/*
 * Copyright (c) 2020 Nordic Semiconductor ASA
 *
 * SPDX-License-Identifier: Apache-2.0
 */

int littlefs_mount_setup(void);
int littlefs_unmount_teardown(void);
```

## src/test_littlefs_dir.c
```c
/*
 * Copyright (c) 2020 Nordic Semiconductor ASA
 *
 * SPDX-License-Identifier: Apache-2.0
 */

#include <stdio.h>
#include <zephyr/fs/fs.h>
#include "test_common.h"
#include "test_littlefs_priv.h"


ZTEST(multifs_fs_dir_file, test_littlefs_mkdir)
{
	zassert_true(test_mkdir(TEST_DIR_PATH, TEST_FILE) == TC_PASS, NULL);
}

ZTEST(multifs_fs_dir_file, test_littlefs_readdir)
{
	zassert_true(test_lsdir(TEST_DIR_PATH) == TC_PASS, NULL);
}

ZTEST(multifs_fs_dir_file, test_littlefs_rmdir)
{
	zassert_true(test_rmdir(TEST_DIR_PATH) == TC_PASS, NULL);
}
```

## src/test_littlefs_file.c
```c
/*
 * Copyright (c) 2018 Intel Corporation.
 *
 * SPDX-License-Identifier: Apache-2.0
 */

#include <zephyr/fs/fs.h>
#include "test_common.h"
#include "test_littlefs_priv.h"

static struct fs_file_t test_file;
static const char *test_str = "Hello world LITTLEFS";

ZTEST(multifs_fs_dir_file, test_littlefs_open)
{
	fs_file_t_init(&test_file);
	zassert_true(test_file_open(&test_file, TEST_FILE_PATH) == TC_PASS,
		NULL);
}

ZTEST(multifs_fs_dir_file, test_littlefs_write)
{
	TC_PRINT("Write to file %s\n", TEST_FILE_PATH);
	zassert_true(test_file_write(&test_file, test_str) == TC_PASS,
		NULL);
}

ZTEST(multifs_fs_dir_file, test_littlefs_read)
{
	zassert_true(test_file_read(&test_file, test_str) == TC_PASS, NULL);
}

ZTEST(multifs_fs_dir_file, test_littlefs_close)
{
	zassert_true(test_file_close(&test_file) == TC_PASS, NULL);
}
ZTEST(multifs_fs_dir_file, test_littlefs_unlink)
{
	zassert_true(test_file_delete(TEST_FILE_PATH) == TC_PASS, NULL);
}
```

## src/test_littlefs_mount.c
```c
/*
 * Copyright (c) 2020 Nordic Semiconductor ASA
 *
 * SPDX-License-Identifier: Apache-2.0
 */

#include <stdint.h>
#include <stdio.h>
#include <zephyr/device.h>
#include <zephyr/fs/fs.h>
#include <ztest.h>
#include <zephyr/fs/littlefs.h>
#include "test_fs_shell.h"

#if !defined(CONFIG_FILE_SYSTEM_SHELL)
FS_LITTLEFS_DECLARE_DEFAULT_CONFIG(storage);

struct fs_mount_t littlefs_mnt = {
	.type = FS_LITTLEFS,
	.fs_data = &storage,
	.storage_dev = (void *)FLASH_AREA_ID(storage),
	.mnt_point = "/littlefs"
};

static int test_mount(void)
{
	int res;

	res = fs_mount(&littlefs_mnt);
	if (res < 0) {
		TC_PRINT("Error mounting littlefs [%d]\n", res);
		return TC_FAIL;
	}

	return TC_PASS;
}

int littlefs_mount_setup(void)
{
	int res;

	res = fs_mount(&littlefs_mnt);
	return res;
}

int littlefs_unmount_teardown(void)
{
	int res;

	res = fs_unmount(&littlefs_mnt);
	return res;
}
#endif

ZTEST(multifs_fs, test_littlefs_mount)
{
#ifdef CONFIG_FILE_SYSTEM_SHELL
	test_fs_littlefs_mount();
#else
	zassert_true(test_mount() == TC_PASS, NULL);
#endif
}
```
